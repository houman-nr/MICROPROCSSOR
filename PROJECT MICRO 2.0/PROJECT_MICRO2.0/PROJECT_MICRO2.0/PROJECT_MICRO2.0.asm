/*
 * PROJECT_MICRO2.asm
 *
 *  Created: 1/19/2023 3:17:34 PM
 *   Author: houman
 */ 

	.INCLUDE "M32DEF.INC"
	.ORG 0
	RJMP main
	.ORG $108
	.DB $10, $24, $02, $15 ;50 / 100 / 10 / 65
	.ORG $400
MAIN:	LDI R16, $00
		OUT DDRA, R16; PORTA IS NOW BEING USED AS IN INPUT
		OUT SFIOR, R16; PULL UP RESISTANT
		IN R24, PINA
		LDI R16, $0F
		OUT DDRB, R16;SETTING THE 
		OUT DDRC, R16; OUTPUT PORTS
		OUT DDRD, R16; FIRST 4 BIT PORT ARE USED FOR
		LDI R16, $00
		OUT PORTB, R16
		LDI R16, $00
		OUT PORTA, R16
		LDI R25, $00
;-----------------------------------------------------------
		LDI R20, 36 ;ENGINE MAX IN PORTC
		LDI R21, 18 ;ENGINE MAX IN PORTD
		LDI R22, 9  ;ENGINE MAX IN PORTB
		LDI R23, 0  ;CHANGED ENGINE
;------------------------------------------------------------
START:	IN R25, PINB
		SBRS R25, 7
		RJMP START
INPUT:	IN R24, PINA
		MOV R29, R24
		LDI R27, $3F
		AND R29, R27
		CPI R24, 00
		BRNE MOT_CH
SAVED:	IN R24, PIND
		CPI R24, $00
		BREQ START
		LDI R31, $02
		SBRC R24, 4;SAVED 1
		RJMP SAVED1
		SBRC R24, 5;SAVED 2
		RJMP SAVED2
		SBRC R24, 6;SAVED 3
		RJMP SAVED3
		SBRC R24, 7;SAVED 4
		RJMP SAVED4
		RJMP START
MOT_CH:	SBRC R25, 4 ;MOTOR CHECK + REVERSE MODE CHECK 
		RJMP RECHECKC4
		SBRC R25, 5
		RJMP RECHECKD4
		SBRC R25, 6
		RJMP RECHECKB4
SAVED1:	LDI R30, $10 ; 50
		LPM R29, Z
		RJMP MOT_CH
SAVED2:	LDI R30, $11 ; 10
		LPM R29, Z
		RJMP MOT_CH
SAVED3:	LDI R30, $12
		LPM R29, Z
		RJMP MOT_CH
SAVED4: LDI R30, $13
		LPM R29, Z
		RJMP MOT_CH
;-------------------------------------------------
RECHECKC4:SBRS R24,7;
		RJMP C4; IF REVERSE MODE IS OFF
		RJMP C4REVERSE; IF REVERSE MODE IS  ON 
;--------------------------------------------------
RECHECKD4:
		SBRS R24,7;
		RJMP D4; IF REVERSE MODE IS OFF
		RJMP D4REVERSE;IF REVERSE MODE IS ON
;--------------------------------------------------
RECHECKB4:
		SBRS R24,7;
		RJMP B4; IF REVERSE MODE IS OFF
		RJMP B4REVERSE;IF REVERSE MODE IS ON
;--------------------------------------------------
C4REVERSE:CP R29, R20
		BRSH C_SET
C_CON:	LDI R16, $04
C_1:	OUT PORTC, R16
		LDI R18, 00
		LDI R19, 00
WAIT_C:	INC R18
		WAIT_CP1:INC R19
				CPI R19, $91
				BRNE WAIT_CP1
		CPI R18, $FF
		BRNE WAIT_C
		LSR R16
		CPI R16, $00
		BREQ SHIFT_C
C_BACK:	DEC R29
		CPI R29, $00
		BRNE C_1
		RJMP RESETC
SHIFT_C:LDI R16, $08
		RJMP C_BACK
C_SET:	MOV R29, R20
		RJMP C_CON		
;+++++++++++++++++++++++++++++++++++++++++++++++
C4:		CP R29, R20
		BRSH C4SET
C4CON:	LDI R16, $01
C1:		OUT PORTC, R16
		LDI R18, 00
		LDI R19, 00
WAITC:	INC R18
		WAITCP1:INC R19
				CPI R19, $91
				BRNE WAITCP1
		CPI R18, $FF
		BRNE WAITC
		LSL R16
		CPI R16, $10
		BREQ SHIFTC
CBACK:	DEC R29
		CPI R29, $00
		BRNE C1
		RJMP RESETC
SHIFTC:	LDI R16, $01
		RJMP CBACK
C4SET:	MOV R29, R20
		RJMP C4CON
;----------------------------------------------------------
;----------------------------------------------------------
D4REVERSE:CP R29, R21
		BRSH D_SET
D_CON:	LDI R16, $04
D_1:	OUT PORTD, R16
		LDI R18, 00
		LDI R19, 00
WAIT_D:	INC R18
		WAIT_DP1:INC R19
				CPI R19, $91
				BRNE WAIT_DP1
		CPI R18, $FF
		BRNE WAIT_D
		LSR R16
		CPI R16, $00
		BREQ SHIFT_D
D_BACK:	DEC R29
		CPI R29, $00
		BRNE D_1
LOOP_D:	SBRS R23, 1
		RJMP RESETD
		RJMP START
SHIFT_D:LDI R16, $08
		RJMP D_BACK
D_SET:	MOV R29, R21
		RJMP D_CON
;++++++++++++++++++++++++++++++++++++++++++++++++++++++++++++
D4:		CP R29, R21
		BRSH D4SET
D4CON:	LDI R16, $01
D1:		OUT PORTD, R16
		LDI R18, 00
		LDI R19, 00
WAITD:	INC R18
		WAITDP1:INC R19
				CPI R19, $91
				BRNE WAITDP1
		CPI R18, $FF
		BRNE WAITD
		LSL R16
		CPI R16, $10
		BREQ SHIFTD
DBACK:	DEC R29
		CPI R29, $00
		BRNE D1
LOOPD:	SBRS R23, 0
		RJMP RESETD
		RJMP START
SHIFTD:	LDI R16, $01
		RJMP DBACK
D4SET:	MOV R29, R21
		RJMP D4CON
;----------------------------------------------------------
B4REVERSE:CP R29, R22
		BRSH B_SET
B_CON:	LDI R16, $04
B_1:	OUT PORTB, R16
		LDI R18, 00
		LDI R19, 00
WAIT_B:	INC R18
		WAIT_BP1:INC R19
				CPI R19, $91
				BRNE WAIT_BP1
		CPI R18, $FF
		BRNE WAIT_B
		LSR R16
		CPI R16, $00
		BREQ SHIFT_B
B_BACK:	DEC R29
		CPI R29, $00
		BRNE B_1
LOOP_B:	SBRS R23, 0
		RJMP RESETB
		RJMP START
SHIFT_B:LDI R16, $08
		RJMP B_BACK
B_SET:	MOV R29, R22
		RJMP B_CON
;++++++++++++++++++++++++++++++++++++++++++++++++++++++++++++++
B4:		CP R29, R22
		BRSH B4SET
B4CON:	LDI R16, $01
B1:		OUT PORTB, R16
		LDI R18, 00
		LDI R19, 00
WAITB:	INC R18
		WAITBP1:INC R19
				CPI R19, $91
				BRNE WAITBP1
		CPI R18, $FF
		BRNE WAITB
		LSL R16
		CPI R16, $10
		BREQ SHIFTB
BBACK:	DEC R29
		CPI R29, $00
		BRNE B1
LOOPB:	SBRS R23, 0
		RJMP RESETB
		RJMP START
SHIFTB:	LDI R16, $01
		RJMP BBACK
B4SET:	MOV R29, R22
		RJMP B4CON
;----------------------------------------------------------reset bottun \/
RESETC:	IN R25, PINB
		SBRS R25, 7
		RJMP RESETC
		LDI R23, $00;FLAG FOR RESET
		MOV R29, R24
		LDI R27, $3F
		AND R29, R27
		IN R16, PINC
		LDI R23, $0F
		SBRS R24,7;
		RJMP C4RE ; IF REVERSE MODE IS  ON
		RJMP C4RERE; IF REVERSE MODE IS OFF
RESETD:	IN R25, PINB
		SBRS R25, 7
		RJMP RESETD
		LDI R23, $00;FLAG FOR RESET
		MOV R29, R24
		LDI R27, $3F
		AND R29, R27
		IN R16, PIND
		LDI R23, $0F
		SBRS R24,7;
		RJMP D4RE ; IF REVERSE MODE IS  ON
		RJMP D4RERE; IF REVERSE MODE IS OFF
RESETB:	IN R25, PINB
		SBRS R25, 7
		RJMP RESETB
		LDI R23, $00;FLAG FOR RESET
		MOV R29, R24
		LDI R27, $3F
		AND R29, R27
		IN R16, PINB
		LDI R23, $0F
		SBRS R24,7;
		RJMP B4RE ; IF REVERSE MODE IS  ON
		RJMP B4RERE; IF REVERSE MODE IS OFF
;------------------------------------------------------;C4 REVERSE RESET
C4RERE:	CP R29, R20
		BRSH C_SETRE
		INC R29
C_1RE:	OUT PORTC, R16
		LDI R18, 00
		LDI R19, 00
WAIT_CRE:INC R18
		WAIT_CP1RE:INC R19
				CPI R19, $91
				BRNE WAIT_CP1RE
		CPI R18, $FF
		BRNE WAIT_CRE
		LSL R16
		CPI R16, $10
		BREQ SHIFT_CRE
C_BACKRE:DEC R29
		CPI R29, $00
		BRNE C_1RE
		RJMP START
SHIFT_CRE:LDI R16, $01
		RJMP C_BACKRE
C_SETRE:MOV R29, R20
		RJMP C_1RE		
;++++++++++++++++++++++++++++++++++++++++++++++++++++++++++;c4 REVERSE
C4RE:	CP R29, R20
		BRSH C4SETRE
		INC R29
C1RE:	OUT PORTC, R16
		LDI R18, 00
		LDI R19, 00
WAITCRE:INC R18
		WAITCP1RE:INC R19
				CPI R19, $91
				BRNE WAITCP1RE
		CPI R18, $FF
		BRNE WAITCRE
		LSR R16
		CPI R16, $00
		BREQ SHIFTCRE
CBACKRE:DEC R29
		CPI R29, $00
		BRNE C1RE
		RJMP START
SHIFTCRE:LDI R16, $08
		RJMP CBACKRE
C4SETRE:MOV R29, R20
		RJMP C1RE
;----------------------------------------------------------
;------------------------------------------------------;D4 REVERSE RESET
D4RERE:	CP R29, R21
		BRSH D_SETRE
		INC R29
D_1RE:	OUT PORTD, R16
		LDI R18, 00
		LDI R19, 00
WAIT_DRE:INC R18
		WAIT_DP1RE:INC R19
				CPI R19, $91
				BRNE WAIT_DP1RE
		CPI R18, $FF
		BRNE WAIT_DRE
		LSL R16
		CPI R16, $10
		BREQ SHIFT_DRE
D_BACKRE:DEC R29
		CPI R29, $00
		BRNE D_1RE
		RJMP START
SHIFT_DRE:LDI R16, $01
		RJMP D_BACKRE
D_SETRE:MOV R29, R21
		RJMP D_1RE		
;++++++++++++++++++++++++++++++++++++++++++++++++++++++++++;D4 REVERSE
D4RE:	CP R29, R21
		BRSH D4SETRE
		INC R29
D1RE:	OUT PORTD, R16
		LDI R18, 00
		LDI R19, 00
WAITDRE:INC R18
		WAITDP1RE:INC R19
				CPI R19, $91
				BRNE WAITDP1RE
		CPI R18, $FF
		BRNE WAITDRE
		LSR R16
		CPI R16, $00
		BREQ SHIFTDRE
DBACKRE:DEC R29
		CPI R29, $00
		BRNE D1RE
		RJMP START
SHIFTDRE:LDI R16, $08
		RJMP DBACKRE
D4SETRE:MOV R29, R21
		RJMP D1RE
;----------------------------------------------------------
;------------------------------------------------------;B4 REVERSE RESET
B4RERE:	CP R29, R22
		BRSH B_SETRE
		INC R29
B_1RE:	OUT PORTB, R16
		LDI R18, 00
		LDI R19, 00
WAIT_BRE:INC R18
		WAIT_BP1RE:INC R19
				CPI R19, $91
				BRNE WAIT_BP1RE
		CPI R18, $FF
		BRNE WAIT_BRE
		LSL R16
		CPI R16, $10
		BREQ SHIFT_BRE
B_BACKRE:DEC R29
		CPI R29, $00
		BRNE B_1RE
		RJMP START
SHIFT_BRE:LDI R16, $01
		RJMP B_BACKRE
B_SETRE:MOV R29, R22
		RJMP B_1RE		
;++++++++++++++++++++++++++++++++++++++++++++++++++++++++++;B4 REVERSE
B4RE:	CP R29, R22
		BRSH B4SETRE
		INC R29
B1RE:	OUT PORTB, R16
		LDI R18, 00
		LDI R19, 00
WAITBRE:INC R18
		WAITBP1RE:INC R19
				CPI R19, $91
				BRNE WAITBP1RE
		CPI R18, $FF
		BRNE WAITBRE
		LSR R16
		CPI R16, $00
		BREQ SHIFTBRE
BBACKRE:DEC R29
		CPI R29, $00
		BRNE B1RE
		RJMP START
SHIFTBRE:LDI R16, $08
		RJMP BBACKRE
B4SETRE:MOV R29, R22
		RJMP B1RE
;----------------------------------------------------------